/dts-v1/;
/plugin/;


/{
	fragment@0 {
		target = <&pwm>;
        __overlay__ {
			pinctrl-names = "default";
			pinctrl-0 = <&pwm0_gpio12>;
			status = "okay";
		};
	};

	fragment@1 {
		target-path = "/";
        __overlay__ {
			pwm_demo: pwm_demo {
				compatible = "pwm-demo";
				status = "okay";
				pwm-names = "pwd-demo";
				pwms = <&pwm 0 10000 1>;
			};
		};
	};
};
