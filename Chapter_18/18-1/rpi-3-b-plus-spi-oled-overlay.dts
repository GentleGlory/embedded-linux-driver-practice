/dts-v1/;
/plugin/;

#include <dt-bindings/gpio/gpio.h>

/{
	fragment@0 {
		target = <&spi0>;
        __overlay__ {
			status = "okay";

			spidev@0 {
				compatible = "rpi3b,spi_oled";
				dc_control_pin = <&gpio 17 GPIO_ACTIVE_HIGH>;
			};
		};
	};
};
