/dts-v1/;
/plugin/;


/{
	fragment@0 {
		target = <&i2c1>;
        __overlay__ {
			status = "okay";

			mpu6056: mpu6056@68 {
				compatible = "rpi3b,i2c_mpu6056";
				reg = <0x68>;
				status = "okay";
			};
		};
	};
};
