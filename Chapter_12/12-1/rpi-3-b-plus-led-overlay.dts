/dts-v1/;
/plugin/;

/{
	fragment@0 {
		target-path = "/";
        __overlay__ {
			led_test: led_test {
				compatible = "fire,led_test";
				status = "okay";
				default-state = "on";
				gpios = <&gpio 17 1>;
				pinctrl-names = "default";
				pinctrl-0 = <&led_test_pins>;
			};
		};
	};

	fragment@1 {
		target = <&gpio>;
        __overlay__ {
			led_test_pins: led_test_pins {
				brcm,pins = <17>;
				brcm,function = <1>; //output
				brcm,pull = <0>;
			};
		};
	};
};
